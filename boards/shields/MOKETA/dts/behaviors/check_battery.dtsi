/ {
    behaviors {
        // Behavior can be invoked on peripherals, so name must be <= 8 characters.
            check_bat: checkbat {
            compatible = "zmk,behavior-check-battery";
            #binding-cells = <0>;
        };
    };
};

