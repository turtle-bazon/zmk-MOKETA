## boards/shields/MOKETA/Kconfig.shield
```kconfig
 #
 # Copyright (c) 2020 The ZMK Contributors
 #
 # SPDX-License-Identifier: MIT
 #

config SHIELD_MOKETA
    def_bool $(shields_list_contains,MOKETA)
```

## config/west.yml
```yaml
manifest:
  remotes:
    - name: zmkfirmware
      url-base: https://github.com/zmkfirmware
      revision: main
  projects:
    - name: zmk
      remote: zmkfirmware
      import: app/west.yml
  self:
    path: config
```
